## main/Kconfig.projbuild
```kconfig
menu "Example Configuration"

    
    # MQTT Configuration
    config MQTT_BROKER_HOST
        string "MQTT broker IP/host"
        default "mqtt://192.168.0.X"
        help
            IP or hostname of the MQTT broker, with or without mqtt:// scheme.

    config MQTT_USERNAME
        string "MQTT username"
        default "MQTT_USERNAME"
        help
            Username for broker authentication.

    config MQTT_PASSWORD
        string "MQTT password"
        default "MQTT_PASSWORD"
        help
            Password for broker authentication.

    config MQTT_TOPICS_LIST
        string "MQTT topics list"
        default "esp_telemetry/cmd;esp_telemetry/config"
        help
            Space-separated list of topics to subscribe after MQTT connection.
            Example: "esp_telemetry/cmd;esp_telemetry/config"
    
    config MQTT_TRY_CONNECT_TIMEOUT_MS
        int "Broker connection timeout (ms)"
        range 1 4294967295
        default 30000
        help
            Define o tempo de espera em milissegundos para tentar conectar ao broker MQTT.
    
    # Wi-Fi Configuration
 
    config ESP_WIFI_SSID
        string "WiFi SSID"
        default "WiFi_SSID"
        help
            SSID (network name) for the example to connect to.

    config ESP_WIFI_PASSWORD
        string "WiFi Password"
        default "WiFi_PASSWORD"
        help
            WiFi password (WPA or WPA2) for the example to use.

    choice ESP_WIFI_SAE_MODE
        prompt "WPA3 SAE mode selection"
        default ESP_STATION_EXAMPLE_WPA3_SAE_PWE_BOTH
        help
            Select mode for SAE as Hunt and Peck, H2E or both.
        config ESP_STATION_EXAMPLE_WPA3_SAE_PWE_HUNT_AND_PECK
            bool "HUNT AND PECK"
        config ESP_STATION_EXAMPLE_WPA3_SAE_PWE_HASH_TO_ELEMENT
            bool "H2E"
            depends on ESP_WIFI_ENABLE_SAE_H2E
        config ESP_STATION_EXAMPLE_WPA3_SAE_PWE_BOTH
            bool "BOTH"
            depends on ESP_WIFI_ENABLE_SAE_H2E
    endchoice

    config ESP_WIFI_PW_ID
        string "PASSWORD IDENTIFIER"
        depends on  ESP_STATION_EXAMPLE_WPA3_SAE_PWE_HASH_TO_ELEMENT|| ESP_STATION_EXAMPLE_WPA3_SAE_PWE_BOTH
        default ""
        help
            password identifier for SAE H2E

    config ESP_MAXIMUM_RETRY
        int "Maximum retry"
        default 5
        help
            Set the Maximum retry to avoid station reconnecting to the AP unlimited when the AP is really inexistent.

    config WIFI_RECONNECT_INTERVAL_SEC
        int "WiFi reconnect interval (s)"
        range 1 3600
        default 60
        help
            Interval in seconds before a new reconnect attempt after reaching the immediate retry limit.

    choice ESP_WIFI_SCAN_AUTH_MODE_THRESHOLD
        prompt "WiFi Scan auth mode threshold"
        default ESP_WIFI_AUTH_WPA2_PSK
        help
            The weakest authmode to accept in the scan mode.
            This value defaults to ESP_WIFI_AUTH_WPA2_PSK in case password is present and ESP_WIFI_AUTH_OPEN is used.
            Please select ESP_WIFI_AUTH_WEP/ESP_WIFI_AUTH_WPA_PSK in case AP is operating in WEP/WPA mode.

        config ESP_WIFI_AUTH_OPEN
            bool "OPEN"
        config ESP_WIFI_AUTH_WEP
            bool "WEP"
        config ESP_WIFI_AUTH_WPA_PSK
            bool "WPA PSK"
        config ESP_WIFI_AUTH_WPA2_PSK
            bool "WPA2 PSK"
        config ESP_WIFI_AUTH_WPA_WPA2_PSK
            bool "WPA/WPA2 PSK"
        config ESP_WIFI_AUTH_WPA3_PSK
            bool "WPA3 PSK"
        config ESP_WIFI_AUTH_WPA2_WPA3_PSK
            bool "WPA2/WPA3 PSK"
        config ESP_WIFI_AUTH_WAPI_PSK
            bool "WAPI PSK"
    endchoice

endmenu
```
